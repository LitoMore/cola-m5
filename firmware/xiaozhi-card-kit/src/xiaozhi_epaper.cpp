#include "xiaozhi_epaper.h"

namespace {
constexpr uint8_t kDataEntryMode = 0x03;
constexpr uint8_t kFullRefresh = 0xF7;
constexpr uint8_t kPartialRefresh = 0xFC;
constexpr uint32_t kSpiFrequency = 10000000;

// Classic 5x7 Adafruit_GFX font, BSD licensed by Adafruit Industries.
static const uint8_t kFont5x7[] PROGMEM = {
  0x00,0x00,0x00,0x00,0x00,0x3E,0x5B,0x4F,0x5B,0x3E,0x3E,0x6B,0x4F,0x6B,0x3E,0x1C,0x3E,0x7C,0x3E,0x1C,
  0x18,0x3C,0x7E,0x3C,0x18,0x1C,0x57,0x7D,0x57,0x1C,0x1C,0x5E,0x7F,0x5E,0x1C,0x00,0x18,0x3C,0x18,0x00,
  0xFF,0xE7,0xC3,0xE7,0xFF,0x00,0x18,0x24,0x18,0x00,0xFF,0xE7,0xDB,0xE7,0xFF,0x30,0x48,0x3A,0x06,0x0E,
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  0x00,0x00,0x77,0x00,0x00,0x00,0x41,0x36,0x08,0x00,0x02,0x01,0x02,0x04,0x02,0x3C,0x26,0x23,0x26,0x3C
};
}  // namespace

bool XiaozhiEpaper::begin() {
  pinMode(kPinCs, OUTPUT);
  pinMode(kPinDc, OUTPUT);
  pinMode(kPinReset, OUTPUT);
  pinMode(kPinBusy, INPUT);
  digitalWrite(kPinCs, HIGH);
  digitalWrite(kPinDc, HIGH);

  spi_.begin(kPinSck, -1, kPinMosi, kPinCs);
  hardwareReset();
  fillScreen(0xFFFF);
  ready_ = true;
  return true;
}

int XiaozhiEpaper::width() const {
  return kWidth;
}

int XiaozhiEpaper::height() const {
  return kHeight;
}

void XiaozhiEpaper::waitDisplay() {
  waitBusy(3000);
}

void XiaozhiEpaper::startWrite() {
}

void XiaozhiEpaper::endWrite() {
}

void XiaozhiEpaper::display() {
  if (!ready_) {
    return;
  }

  setWindow(0, 0, kWidth, kHeight);
  sendCommand(0x24);
  sendData(buffer_, sizeof(buffer_));

  uint8_t refreshMode = firstRefresh_ ? kFullRefresh : kPartialRefresh;
  if (triggerRefresh(refreshMode)) {
    firstRefresh_ = false;
  }
}

void XiaozhiEpaper::fillScreen(uint16_t color) {
  memset(buffer_, isInkColor(color) ? 0xFF : 0x00, sizeof(buffer_));
}

void XiaozhiEpaper::drawFastHLine(int32_t x, int32_t y, int32_t w, uint16_t color) {
  bool ink = isInkColor(color);
  for (int32_t dx = 0; dx < w; ++dx) {
    drawPixel(x + dx, y, ink);
  }
}

void XiaozhiEpaper::drawRoundRect(int32_t x, int32_t y, int32_t w, int32_t h, int32_t, uint16_t color) {
  bool ink = isInkColor(color);
  drawFastHLine(x, y, w, color);
  drawFastHLine(x, y + h - 1, w, color);
  drawVLine(x, y, h, ink);
  drawVLine(x + w - 1, y, h, ink);
}

void XiaozhiEpaper::setTextSize(uint8_t size) {
  textSize_ = max<uint8_t>(1, size);
}

void XiaozhiEpaper::setTextColor(uint16_t color, uint16_t background) {
  textInk_ = isInkColor(color);
  textBgInk_ = isInkColor(background);
}

void XiaozhiEpaper::setCursor(int32_t x, int32_t y) {
  cursorX_ = x;
  cursorY_ = y;
}

void XiaozhiEpaper::setTextScroll(bool) {
}

void XiaozhiEpaper::setBrightness(uint8_t) {
}

uint8_t XiaozhiEpaper::getEpdMode() const {
  return firstRefresh_ ? kFullRefresh : kPartialRefresh;
}

size_t XiaozhiEpaper::write(uint8_t value) {
  if (value == '\r') {
    return 1;
  }
  if (value == '\n') {
    cursorX_ = 0;
    cursorY_ += 8 * textSize_;
    return 1;
  }

  drawChar(static_cast<char>(value));
  cursorX_ += 6 * textSize_;
  return 1;
}

void XiaozhiEpaper::hardwareReset() {
  digitalWrite(kPinReset, LOW);
  delay(10);
  digitalWrite(kPinReset, HIGH);
  delay(10);
}

void XiaozhiEpaper::sendCommand(uint8_t command) {
  spi_.beginTransaction(SPISettings(kSpiFrequency, MSBFIRST, SPI_MODE0));
  digitalWrite(kPinDc, LOW);
  digitalWrite(kPinCs, LOW);
  spi_.transfer(command);
  digitalWrite(kPinCs, HIGH);
  digitalWrite(kPinDc, HIGH);
  spi_.endTransaction();
}

void XiaozhiEpaper::sendData(uint8_t data) {
  sendData(&data, 1);
}

void XiaozhiEpaper::sendData(const uint8_t* data, size_t length) {
  if (data == nullptr || length == 0) {
    return;
  }

  spi_.beginTransaction(SPISettings(kSpiFrequency, MSBFIRST, SPI_MODE0));
  digitalWrite(kPinDc, HIGH);
  digitalWrite(kPinCs, LOW);
  spi_.writeBytes(data, length);
  digitalWrite(kPinCs, HIGH);
  spi_.endTransaction();
}

void XiaozhiEpaper::setWindow(int xStart, int yStart, int xEnd, int yEnd) {
  sendCommand(0x11);
  sendData(kDataEntryMode);

  uint8_t xRange[] = {
    static_cast<uint8_t>(xStart / 8),
    static_cast<uint8_t>((xEnd - 1) / 8),
  };
  sendCommand(0x44);
  sendData(xRange, sizeof(xRange));

  uint16_t yStartLine = yStart;
  uint16_t yEndLine = yEnd - 1;
  uint8_t yRange[] = {
    static_cast<uint8_t>(yStartLine & 0xFF),
    static_cast<uint8_t>(yStartLine >> 8),
    static_cast<uint8_t>(yEndLine & 0xFF),
    static_cast<uint8_t>(yEndLine >> 8),
  };
  sendCommand(0x45);
  sendData(yRange, sizeof(yRange));

  sendCommand(0x4E);
  sendData(static_cast<uint8_t>(xStart / 8));

  uint8_t yCounter[] = {
    static_cast<uint8_t>(yStart & 0xFF),
    static_cast<uint8_t>(yStart >> 8),
  };
  sendCommand(0x4F);
  sendData(yCounter, sizeof(yCounter));
}

bool XiaozhiEpaper::triggerRefresh(uint8_t mode) {
  sendCommand(0x22);
  sendData(mode);
  sendCommand(0x20);
  return waitBusy(3000);
}

bool XiaozhiEpaper::waitBusy(unsigned long timeoutMs) {
  unsigned long start = millis();
  while (digitalRead(kPinBusy) == HIGH) {
    if (millis() - start > timeoutMs) {
      Serial.printf("[xiaozhi-card-kit] epaper busy timeout after %lums\n", timeoutMs);
      return false;
    }
    delay(5);
  }
  return true;
}

void XiaozhiEpaper::drawPixel(int32_t x, int32_t y, bool ink) {
  if (x < 0 || x >= kWidth || y < 0 || y >= kHeight) {
    return;
  }

  size_t byteIndex = y * kBytesPerRow + (x / 8);
  uint8_t bit = 7 - (x % 8);
  if (ink) {
    buffer_[byteIndex] |= (1U << bit);
  } else {
    buffer_[byteIndex] &= ~(1U << bit);
  }
}

void XiaozhiEpaper::drawVLine(int32_t x, int32_t y, int32_t h, bool ink) {
  for (int32_t dy = 0; dy < h; ++dy) {
    drawPixel(x, y + dy, ink);
  }
}

void XiaozhiEpaper::drawChar(char value) {
  uint8_t c = static_cast<uint8_t>(value);
  if (c >= 128) {
    c = '?';
  }

  for (uint8_t col = 0; col < 6; ++col) {
    uint8_t line = col < 5 ? pgm_read_byte(&kFont5x7[c * 5 + col]) : 0;
    for (uint8_t row = 0; row < 8; ++row) {
      bool ink = (line & (1U << row)) != 0 ? textInk_ : textBgInk_;
      for (uint8_t sx = 0; sx < textSize_; ++sx) {
        for (uint8_t sy = 0; sy < textSize_; ++sy) {
          drawPixel(cursorX_ + col * textSize_ + sx, cursorY_ + row * textSize_ + sy, ink);
        }
      }
    }
  }
}

bool XiaozhiEpaper::isInkColor(uint16_t color) const {
  return color != 0xFFFF;
}
